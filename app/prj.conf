## Kconfig
```
#
# Copyright (c) 2019 Nordic Semiconductor
#
# SPDX-License-Identifier: LicenseRef-Nordic-5-Clause
#

source "Kconfig.zephyr"

menu "Nordic Serial Modem"

config SM_CUSTOMER_VERSION
	string "Customer version string"
	help
	   This version is reported together with baseline versions by AT command "#XSMVER".

config SM_AT_BUF_SIZE
	int "AT command buffer size"
	range 128 8192
	default 4096
	help
	  Size of the buffer for incoming AT commands and modem responses.

#
# external XTAL for UART
#
config SM_EXTERNAL_XTAL
	bool "Use external XTAL for UARTE"
	default y

#
# AT command terminator
#
choice
	prompt "Termination mode"
	default SM_CR_TERMINATION
	help
	  Sets the command terminator used by the serial terminal.
	  Available options are:
	  -  CR termination
	  -  LF termination
	  -  CR+LF termination

config SM_CR_TERMINATION
	bool "CR termination"

config SM_LF_TERMINATION
	bool "LF termination"

config SM_CR_LF_TERMINATION
	bool "CR+LF termination"

endchoice

#
# UART buffers (when CMUX is not in use)
#
config SM_UART_RX_BUF_COUNT
	int "Receive buffers for UART"
	range 2 4
	default 3
	help
	  Amount of buffers for receiving (RX) UART traffic.
	  If the buffers are full, UART RX will be disabled until the buffers are processed.
	  These buffers are not used when CMUX is in use.

config SM_UART_RX_BUF_SIZE
	int "Receive buffer size for UART"
	range 128 4096
	default 2048 if BOARD_THINGY91X_NRF9151_NS
	default 256
	help
	  Amount of received (RX), unprocessed, UART traffic that can be held by single buffer.
	  Increase buffer space for Thingy:91 X as hardware flow control is not used.
	  These buffers are not used when CMUX is in use.

config SM_UART_TX_BUF_SIZE
	int "Send buffer size for UART"
	range 128 4096
	default 256
	help
	  Amount of UART traffic waiting to be sent (TX), that can be held.
	  If the buffers are full, will send synchronously.
	  These buffers are not used when CMUX is in use.

config SM_URC_BUFFER_SIZE
	int "TX buffer size for unsolicited result codes (URC)"
	default 4096
	help
	  Buffer, in which unsolicited result codes (URC) are stored before being sent to the host.
	  The buffer has to be large enough to hold the largest URC that can be sent by the modem.
	  Result codes longer than this size will get dropped.

	  The URC in here means an URC from the Modem or from a thread which is not serving sm_work_queue.
	  Messages that are originally sent from sm_work_queue are part of AT-command responses, even though they are indistinguishable from the URCs.

	  This can be reduced if your use cases do not require lengthy notifications.
	  Note: %NCELLMEAS notifications can be nearly 4kB in size,
	  which explains the default value.

config SM_AT_ECHO_MAX_LEN
	int "Maximum length of AT command echo"
	range 2 4096
	default 4096
	help
	  Maximum length of AT command echo that will be sent back to the host when AT command echo is enabled.
	  AT commands longer than this value will be truncated in the echo.
	  The AT command terminator is included in this length and it is always echoed.

config SM_URC_DELAY_WITH_INCOMPLETE_ECHO_MS
	int "Delay for URC transmission when incomplete AT command echo is in progress (ms)"
	default 1000
	help
	  When AT command echo is enabled, and the command is spread over multiple RX buffers,
	  due to its length, or the speed of incoming data (typing), the command echo is considered incomplete
	  until the final part of the command (terminating character) has been received and echoed back to the host.

	  When the AT command echo is incomplete, URC transmissions are delayed by this amount of time for every
	  RX buffer (keystroke, while typing) received until the command echo is complete.

#
# Automatic network attach
#
config SM_AUTO_CONNECT
	bool "Automatically connect to the network on start-up or after a reset"
	help
	  Enables automatic connection to the network using the PDN configuration.

if SM_AUTO_CONNECT

config SM_AUTO_CONNECT_SYSTEM_MODE
	string "System mode for automatic network attach"
	default "1,1,1,0"
	help
	  Defines the default system mode using '%XSYSTEMMODE' AT command for automatic network attach.
	  The format is a comma-separated list of four integers. See the AT command reference for +XSYSTEMMODE for more details.
	  Default value enables LTE-M, NB-IoT, and GNSS, with no LTE preference.

config SM_AUTO_CONNECT_PDN_CONFIG
	bool "PDN configuration for automatic network attach"
	help
	  Enables sending of PDN configuration during automatic network attach.

if SM_AUTO_CONNECT_PDN_CONFIG

config SM_AUTO_CONNECT_PDN_APN
	string "APN for automatic network attach"
	default ""
	help
	  APN to use for automatic network attach.
	  If left empty, the APN configured in the modem will be used.

choice SM_AUTO_CONNECT_PDN_FAMILY
	prompt "PDN family (IP type) for automatic network attach"
	default SM_AUTO_CONNECT_PDN_FAMILY_IPV4V6
	help
	  Select the PDN family (IP address type) to use for automatic network attach.
	  See AT command reference for +CGDCONT for more details.

config SM_AUTO_CONNECT_PDN_FAMILY_IP
	bool "IPv4"
	help
	  Use IPv4 only for the PDN connection.

config SM_AUTO_CONNECT_PDN_FAMILY_IPV6
	bool "IPv6"
	help
	  Use IPv6 only for the PDN connection.

config SM_AUTO_CONNECT_PDN_FAMILY_IPV4V6
	bool "IPv4 and IPv6"
	help
	  Use both IPv4 and IPv6 for the PDN connection (dual stack).

config SM_AUTO_CONNECT_PDN_FAMILY_NON_IP
	bool "Non-IP"
	help
	  Use Non-IP PDN type for the connection.
	  This is used for data transmission without IP headers.

endchoice

config SM_AUTO_CONNECT_PDN_FAMILY_STRING
	string
	default "IP" if SM_AUTO_CONNECT_PDN_FAMILY_IP
	default "IPV6" if SM_AUTO_CONNECT_PDN_FAMILY_IPV6
	default "IPV4V6" if SM_AUTO_CONNECT_PDN_FAMILY_IPV4V6
	default "Non-IP" if SM_AUTO_CONNECT_PDN_FAMILY_NON_IP
	help
	  Internal use only. Represents the selected PDN family as a string.

config SM_AUTO_CONNECT_PDN_AUTH
	int "PDN authentication type for automatic network attach"
	default 0
	range 0 2
	help
	  PDN authentication type to use for automatic network attach.
	  0 = None
	  1 = PAP
	  2 = CHAP

config SM_AUTO_CONNECT_PDN_USERNAME
	string "PDN username for automatic network attach"
	default ""
	help
	  PDN username to use for automatic network attach.
	  Leave empty if no username is required.

config SM_AUTO_CONNECT_PDN_PASSWORD
	string "PDN password for automatic network attach"
	default ""
	help
	  PDN password to use for automatic network attach.
	  Leave empty if no password is required.

endif # SM_AUTO_CONNECT_PDN_CONFIG
endif # SM_AUTO_CONNECT

#
# Data mode
#
config SM_DATAMODE_TERMINATOR
	string "Pattern string to terminate data mode"
	default "+++"
	help
	  Use a pattern to terminate data mode

config SM_DATAMODE_BUF_SIZE
	int "Buffer size for data mode"
	range 1024 8192
	default 4096
	help
	  Size of the buffer for data received in data mode.

#
# Configurable services
#
config SM_SMS
	bool "SMS support"
	default y
	select SMS if UNKNOWN_KCONFIG
	help
	  Support SMS send/receive in plain text

config SM_GNSS
	bool "GNSS support"
	default y

config SM_NRF_CLOUD
	bool "nRF Cloud support"
	default y
	select EXPERIMENTAL

if SM_NRF_CLOUD
config HEAP_MEM_POOL_ADD_SIZE_SM_NRF_CLOUD
	int "Additional heap memory pool size for nRF Cloud support"
	default 8192
	help
	  Some libraries used by nRF Cloud use System Heap (k_malloc() / k_free()) for
	  dynamic memory allocation.
endif # SM_NRF_CLOUD

config SM_NRF_CLOUD_LOCATION
	bool "nRF Cloud Location support"
	depends on SM_NRF_CLOUD
	help
	  Enable the nRF Cloud Location service for cloud-assisted geolocation.
	  Supports cellular and Wi-Fi positioning.

config SM_MQTTC
	bool "MQTT client support"
	default y
	select MQTT_LIB
	select MQTT_LIB_TLS
	select EXPERIMENTAL

config SM_FULL_FOTA
	bool "Full modem FOTA support"

config SM_DFU_MODEM_FULL
	bool "Full modem DFU support"

config SM_PPP
	bool "PPP support"

config SM_CMUX
	bool "CMUX support"

config SM_CMUX_CHANNEL_COUNT
	int "Number of CMUX channels"
	depends on SM_CMUX
	default 2
	range 1 63
	help
	  Number of channels to be used by the CMUX implementation.
	  Each channel adds about 4 kB of RAM usage for buffers.

if SM_PPP

config SM_PPP_FALLBACK_MTU
	int "Fallback MTU to be used by PPP"
	default 1280
	help
	  PPP tries to retrieve the cellular link MTU from the modem (using `AT+CGCONTRDP`).
	  If no MTU is returned by the modem, this value will be used as a fallback.
	  The MTU will be used for sending and receiving of data on both the PPP and cellular links.

endif # SM_PPP

if SM_CMUX || SM_PPP

config SM_MODEM_PIPE_TIMEOUT
	int "Timeout for the CMUX and PPP modem pipe operations in seconds"
	default 10

endif # SM_CMUX || SM_PPP

if SM_MQTTC

config SM_MQTTC_MESSAGE_BUFFER_LEN
	int "Size of the buffer for MQTT library"
	default 512
	help
	  Specifies maximum message size that can be transmitted/received through
	  MQTT (excluding MQTT PUBLISH payload).

endif # SM_MQTTC

if SM_GNSS

config SM_GNSS_OUTPUT_NMEA_SATELLITES
	bool "Output NMEA satellite messages (GSV, GSA)"
	default y if SM_LOG_LEVEL_DBG
	depends on SM_LOG_LEVEL_DBG
	help
	  If enabled, NMEA messages that pertain to the satellites will be output
	  along with the other NMEA messages. Those are output in debug logs.

config SM_PGPS_INJECT_FIX_DATA
	bool "Inject the data obtained when acquiring a fix"
	default y
	depends on SM_GNSS
	depends on SM_NRF_CLOUD
	depends on NRF_CLOUD_PGPS
	help
	  If enabled, when a fix is acquired the current location and time will
	  be passed to the P-GPS subsystem.
	  It allows to speed up the time it takes to acquire the next fix when
	  A-GNSS is disabled or unavailable.
	  This can be detrimental to short TTFF if the device is expected to move
	  distances longer than a few dozen kilometers between fix attempts.
	  In that case this option should be disabled.

endif # SM_GNSS

if NRF_MODEM_LIB_TRACE

choice NRF_MODEM_LIB_TRACE_BACKEND

config SM_MODEM_TRACE_BACKEND_CMUX
	bool "CMUX modem trace backend"
	depends on SM_CMUX_CHANNEL_COUNT > 2
	help
	  When CMUX is enabled, modem traces are transmitted on a dedicated CMUX channel.
	  The trace channel is the first channel after the AT command channel and the PPP channel.

endchoice # NRF_MODEM_LIB_TRACE_BACKEND

endif

#
# Hardware RX byte counting for UART
#
# Either hardware flow control OR hardware RX byte counting is required to prevent RX data loss.
# When hw-flow-control is enabled in devicetree, it handles flow management efficiently.
# When hw-flow-control is disabled, hardware RX byte counting is enabled to prevent data loss,
# but it consumes more power due to additional timer usage.
#
if UART_ASYNC_API

config UART_0_NRF_HW_ASYNC
	default y if HAS_HW_NRF_UARTE0 && !$(dt_nodelabel_bool_prop,uart0,hw-flow-control)

config UART_0_NRF_HW_ASYNC_TIMER
	default 0 if HAS_HW_NRF_UARTE0 && !$(dt_nodelabel_bool_prop,uart0,hw-flow-control)

config UART_2_NRF_HW_ASYNC
	default y if HAS_HW_NRF_UARTE2 && !$(dt_nodelabel_bool_prop,uart2,hw-flow-control)

config UART_2_NRF_HW_ASYNC_TIMER
	default 2 if HAS_HW_NRF_UARTE2 && !$(dt_nodelabel_bool_prop,uart2,hw-flow-control)

endif # UART_ASYNC_API

module = SM
module-str = serial modem
source "$(ZEPHYR_BASE)/subsys/logging/Kconfig.template.log_config"

rsource "src/lwm2m_carrier/Kconfig"

endmenu
```

## sample.yaml
```
sample:
  name: Serial Modem
tests:
  serial_modem.nrf91m1:
    sysbuild: true
    build_only: true
    extra_args:
      - EXTRA_CONF_FILE="cmux.conf;ppp.conf;trace-backend-uart.conf;nrf-device-provisioning.conf"
      - EXTRA_DTC_OVERLAY_FILE="nrf91m1.overlay;trace-backend.overlay"
    extra_configs:
      - CONFIG_SM_LOG_LEVEL_DBG=y
      # tasta poistettiin
    platform_allow:
      - nrf9151dk/nrf9151/ns
  # The nRF91M1 configuration is the one that carries the most Kconfig fragments and
  # devicetree overlays, so this guards that the coredump partition still composes with
  # all of them.
  serial_modem.nrf91m1.coredump:
    sysbuild: true
    build_only: true
    extra_args:
      - EXTRA_CONF_FILE="cmux.conf;ppp.conf;trace-backend-uart.conf;nrf-device-provisioning.conf;nrfcloud-coredump-flash.conf"
      - EXTRA_DTC_OVERLAY_FILE="nrf91m1.overlay;trace-backend.overlay;nrfcloud-coredump-flash.overlay"
      - mcuboot_EXTRA_DTC_OVERLAY_FILE="${APP_DIR}/nrfcloud-coredump-flash.overlay"
    extra_configs:
      - CONFIG_SM_LOG_LEVEL_DBG=y
    platform_allow:
      - nrf9151dk/nrf9151/ns
    integration_platforms:
      - nrf9151dk/nrf9151/ns
  serial_modem.default:
    sysbuild: true
    build_only: true
    platform_allow:
      - nrf9151dk/nrf9151/ns
      - thingy91x/nrf9151/ns
  serial_modem.extmcu:
    sysbuild: true
    build_only: true
    extra_args:
      - EXTRA_DTC_OVERLAY_FILE="external-mcu.overlay"
    platform_allow:
      - nrf9151dk/nrf9151/ns
    tags: exclude_integration
  serial_modem.extmcu.mtrace:
    sysbuild: true
    build_only: true
    extra_args:
      - EXTRA_CONF_FILE="trace-backend-uart.conf"
      - EXTRA_DTC_OVERLAY_FILE="external-mcu.overlay;trace-backend.overlay"
    platform_allow:
      - nrf9151dk/nrf9151/ns
  serial_modem.no_dtr:
    sysbuild: true
    build_only: true
    extra_args:
      - EXTRA_DTC_OVERLAY_FILE="disable-dtr.overlay"
    platform_allow:
      - nrf9151dk/nrf9151/ns
      - thingy91x/nrf9151/ns
    tags: exclude_integration
  serial_modem.ppp_without_cmux:
    sysbuild: true
    build_only: true
    extra_args:
      - EXTRA_CONF_FILE="ppp.conf"
    platform_allow:
      - nrf9151dk/nrf9151/ns
      - thingy91x/nrf9151/ns
    integration_platforms:
      - nrf9151dk/nrf9151/ns
  serial_modem.ppp_cmux:
    sysbuild: true
    build_only: true
    extra_args:
      - EXTRA_CONF_FILE="cmux.conf;ppp.conf"
    platform_allow:
      - nrf9151dk/nrf9151/ns
      - thingy91x/nrf9151/ns
    tags: exclude_integration
  serial_modem.ppp_cmux.mtrace:
    sysbuild: true
    build_only: true
    extra_args:
      - EXTRA_CONF_FILE="cmux.conf;ppp.conf;trace-backend-uart.conf"
      - EXTRA_DTC_OVERLAY_FILE="trace-backend.overlay"
    extra_configs:
      - CONFIG_SM_LOG_LEVEL_DBG=y
    platform_allow:
      - nrf9151dk/nrf9151/ns
      - thingy91x/nrf9151/ns
    integration_platforms:
      - nrf9151dk/nrf9151/ns
  serial_modem.ppp_cmux_with_extmcu:
    sysbuild: true
    build_only: true
    extra_args:
      - EXTRA_CONF_FILE="cmux.conf;ppp.conf"
      - EXTRA_DTC_OVERLAY_FILE="external-mcu.overlay"
    platform_allow:
      - nrf9151dk/nrf9151/ns
    tags: exclude_integration
  serial_modem.ppp_cmux_with_extmcu.mtrace:
    sysbuild: true
    build_only: true
    extra_args:
      - EXTRA_CONF_FILE="cmux.conf;ppp.conf;trace-backend-uart.conf"
      - EXTRA_DTC_OVERLAY_FILE="external-mcu.overlay;trace-backend.overlay"
    extra_configs:
      - CONFIG_SM_LOG_LEVEL_DBG=y
    platform_allow:
      - nrf9151dk/nrf9151/ns
    tags: exclude_integration
  serial_modem.ppp_cmux_with_modem_trace:
    sysbuild: true
    build_only: true
    extra_args:
      - EXTRA_CONF_FILE="cmux.conf;ppp.conf;trace-backend-cmux.conf"
      - EXTRA_DTC_OVERLAY_FILE="trace-backend.overlay"
    platform_allow:
      - nrf9151dk/nrf9151/ns
      - thingy91x/nrf9151/ns
    integration_platforms:
      - nrf9151dk/nrf9151/ns
  # Only nrf9151dk is covered. thingy91x has no free internal flash, so a coredump partition
  # there would require shrinking slot0 and cascading matching changes into the b0/mcuboot
  # images - out of scope for this minimal overlay.
  serial_modem.memfault:
    sysbuild: true
    build_only: true
    extra_args:
      - EXTRA_CONF_FILE=nrfcloud-coredump-flash.conf
      - EXTRA_DTC_OVERLAY_FILE="nrfcloud-coredump-flash.overlay"
      - mcuboot_EXTRA_DTC_OVERLAY_FILE="${APP_DIR}/nrfcloud-coredump-flash.overlay"
    # No CONFIG_MEMFAULT_NCS_PROJECT_KEY is set on purpose: an empty project key
    # makes the device rely on the nRF Cloud server-side routing, which is what a
    # user without a Memfault project key gets. Setting a placeholder key here
    # would be injected as CoAP option 2429 and make every upload fail.
    platform_allow:
      - nrf9151dk/nrf9151/ns
    integration_platforms:
      - nrf9151dk/nrf9151/ns
  # Memfault is enabled in prj.conf, so this guards the opposite configuration: every
  # option Memfault needs is a configdefault in Kconfig.memfault, and assigning any of
  # them in prj.conf instead both warns and leaves an unbuildable configuration, because
  # nothing implements nrf_cloud_coap_get_user_options() without the Memfault CoAP port.
  serial_modem.no_memfault:
    sysbuild: true
    build_only: true
    extra_configs:
      - CONFIG_MEMFAULT=n
    platform_allow:
      - nrf9151dk/nrf9151/ns
    integration_platforms:
      - nrf9151dk/nrf9151/ns
  serial_modem.mfw_full_fota_and_dfu:
    sysbuild: true
    build_only: true
    extra_args:
      - EXTRA_CONF_FILE="full-fota.conf"
      - EXTRA_DTC_OVERLAY_FILE="full-fota.overlay"
    extra_configs:
      - CONFIG_SM_DFU_MODEM_FULL=y
    platform_allow:
      - nrf9151dk/nrf9151/ns
  serial_modem.pgps_agnss:
    sysbuild: true
    build_only: true
    extra_args:
      - EXTRA_DTC_OVERLAY_FILE="pgps.overlay"
      - mcuboot_EXTRA_DTC_OVERLAY_FILE="${APP_DIR}/pgps.overlay"
    extra_configs:
      - CONFIG_NRF_CLOUD_PGPS=y
    platform_allow:
      - nrf9151dk/nrf9151/ns
  serial_modem.pgps_no_agnss:
    sysbuild: true
    build_only: true
    extra_args:
      - EXTRA_DTC_OVERLAY_FILE="pgps.overlay"
      - mcuboot_EXTRA_DTC_OVERLAY_FILE="${APP_DIR}/pgps.overlay"
    extra_configs:
      - CONFIG_NRF_CLOUD_PGPS=y
      - CONFIG_NRF_CLOUD_AGNSS=n
    platform_allow:
      - nrf9151dk/nrf9151/ns
    tags: exclude_integration
  serial_modem.lwm2m_carrier:
    sysbuild: true
    build_only: true
    extra_args:
      - EXTRA_CONF_FILE="carrier.conf"
      - EXTRA_DTC_OVERLAY_FILE="carrier.overlay"
    platform_allow:
      - nrf9151dk/nrf9151/ns
    integration_platforms:
      - nrf9151dk/nrf9151/ns
  serial_modem.lwm2m_carrier.softbank:
    sysbuild: true
    build_only: true
    extra_args:
      - EXTRA_CONF_FILE="carrier.conf;carrier-softbank.conf"
      - EXTRA_DTC_OVERLAY_FILE="carrier.overlay"
      - SB_EXTRA_CONF_FILE=sysbuild-softbank.conf
    platform_allow:
      - nrf9151dk/nrf9151/ns
    tags: exclude_integration
  serial_modem.lwm2m_carrier.lgu:
    sysbuild: true
    build_only: true
    extra_args:
      - EXTRA_CONF_FILE="carrier.conf;carrier-lgu.conf"
      - EXTRA_DTC_OVERLAY_FILE="carrier.overlay"
    platform_allow:
      - nrf9151dk/nrf9151/ns
    tags: exclude_integration
  serial_modem.auto_connect:
    sysbuild: true
    build_only: true
    extra_configs:
      - CONFIG_SM_AUTO_CONNECT=y
      - CONFIG_SM_AUTO_CONNECT_SYSTEM_MODE="1,0,0,0"
      - CONFIG_SM_AUTO_CONNECT_PDN_CONFIG=y
      - CONFIG_SM_AUTO_CONNECT_PDN_APN="internet"
      - CONFIG_SM_AUTO_CONNECT_PDN_FAMILY_IP=y
      - CONFIG_SM_AUTO_CONNECT_PDN_AUTH=1
      - CONFIG_SM_AUTO_CONNECT_PDN_USERNAME="myuser"
      - CONFIG_SM_AUTO_CONNECT_PDN_PASSWORD="mypassword"
    platform_allow:
      - nrf9151dk/nrf9151/ns
    tags: exclude_integration
  serial_modem.disable_b0:
    sysbuild: true
    build_only: true
    extra_args:
      - EXTRA_DTC_OVERLAY_FILE="disable-b0.overlay"
      - mcuboot_EXTRA_DTC_OVERLAY_FILE="${APP_DIR}/disable-b0.overlay"
      - SB_CONFIG_SECURE_BOOT_APPCORE=n
    platform_allow:
      - nrf9151dk/nrf9151/ns
  serial_modem.debug_stats_stacks:
    sysbuild: true
    build_only: true
    extra_configs:
      - CONFIG_SM_DEBUG_STATS_THREAD_STACK=y
      - CONFIG_SYS_HEAP_INFO=y
      - CONFIG_LOG_BUFFER_SIZE=2048
    platform_allow:
      - nrf9151dk/nrf9151/ns
    tags: exclude_integration
```

## prj.conf
```kconfig
#
# Copyright (c) 2020 Nordic Semiconductor ASA
#
# SPDX-License-Identifier: LicenseRef-Nordic-5-Clause
#
# General config
CONFIG_LOG=y
CONFIG_ASSERT=y
CONFIG_ASSERT_VERBOSE=n
CONFIG_LOG_DEFAULT_LEVEL=3
CONFIG_STACK_SENTINEL=y
CONFIG_PICOLIBC_IO_FLOAT=y
CONFIG_RING_BUFFER=y
CONFIG_REBOOT=y
CONFIG_EVENTFD=y

# Segger RTT
CONFIG_USE_SEGGER_RTT=y
# Where console messages (printk) are output.
# By itself, SM does not output any.
CONFIG_RTT_CONSOLE=y
CONFIG_UART_CONSOLE=n
# Where logs are output.
CONFIG_LOG_BACKEND_RTT=y
CONFIG_LOG_BACKEND_UART=n
# Increase the buffer so that all Serial Modem boot logs fit into the buffer.
# Because J-Link RTT Viewer has to be connected after the bootup,
# only logs that fit into the buffer are shown. This is especially useful in showing
# errors if Serial Modem does not start properly.
CONFIG_SEGGER_RTT_BUFFER_SIZE_UP=2048

# Network
CONFIG_NETWORKING=y
CONFIG_NET_SOCKETS=y
CONFIG_NET_NATIVE=n
CONFIG_NET_IPV4=y
CONFIG_NET_IPV6=y

# Modem library
CONFIG_NRF_MODEM_LIB=y
CONFIG_AT_CMD_CUSTOM=y
# Align the max FD entry to NRF_MODEM_MAX_SOCKET_COUNT(8)
CONFIG_ZVFS_OPEN_MAX=8

# Handle modem fault
CONFIG_NRF_MODEM_LIB_ON_FAULT_APPLICATION_SPECIFIC=y

# Use GPIO
CONFIG_GPIO=y
CONFIG_GPIO_NRFX=y

# UART interface
CONFIG_SERIAL=y
CONFIG_UART_USE_RUNTIME_CONFIGURE=y
CONFIG_UART_ASYNC_API=y
CONFIG_UART_INTERRUPT_DRIVEN=n
CONFIG_NRFX_TIMER=y

# Stacks and heaps
CONFIG_MAIN_STACK_SIZE=4096
CONFIG_HEAP_MEM_POOL_SIZE=16384
CONFIG_SYSTEM_WORKQUEUE_STACK_SIZE=4096
CONFIG_AT_MONITOR_HEAP_SIZE=4096

# Device power management
CONFIG_PM_DEVICE=y
CONFIG_PM_DEVICE_RUNTIME=n

# FOTA
CONFIG_HTTP_PARSER_URL=y
CONFIG_FOTA_DOWNLOAD=y
CONFIG_FOTA_DOWNLOAD_PROGRESS_EVT=y
CONFIG_DFU_TARGET=y
CONFIG_DOWNLOADER=y
CONFIG_DOWNLOADER_STACK_SIZE=4096
CONFIG_DOWNLOADER_MAX_FILENAME_SIZE=2048
CONFIG_BOOTLOADER_MCUBOOT=y
CONFIG_IMG_MANAGER=y

# FLASH
CONFIG_FLASH=y
CONFIG_FLASH_PAGE_LAYOUT=y
CONFIG_FLASH_MAP=y
CONFIG_STREAM_FLASH=y
CONFIG_MPU_ALLOW_FLASH_WRITE=y
CONFIG_IMG_ERASE_PROGRESSIVELY=y

# Settings
CONFIG_SETTINGS=y
CONFIG_SETTINGS_NVS=y
CONFIG_NVS=y

# nRF Cloud
CONFIG_NRF_CLOUD=y
CONFIG_NRF_CLOUD_MQTT=y
CONFIG_NRF_CLOUD_FOTA=n
CONFIG_NRF_CLOUD_AGNSS=y
CONFIG_NRF_CLOUD_AGNSS_FILTERED=n
CONFIG_NRF_CLOUD_PGPS=n
CONFIG_NRF_CLOUD_LOCATION=y
CONFIG_NRF_CLOUD_LOG_LEVEL_INF=y
CONFIG_NRF_CLOUD_GPS_LOG_LEVEL_INF=y
CONFIG_NRF_CLOUD_CLIENT_ID_SRC_INTERNAL_UUID=y
CONFIG_NRF_CLOUD_WIFI_LOCATION_ENCODE_OPT_MAC_RSSI=y
CONFIG_DATE_TIME=y
CONFIG_MODEM_INFO=y
CONFIG_MODEM_INFO_ADD_DATE_TIME=n

# LTE Link Control required for nRF Cloud location
CONFIG_LTE_LINK_CONTROL=y
CONFIG_LTE_LC_NEIGHBOR_CELL_MEAS_MODULE=y
CONFIG_LTE_LC_FUNCTIONAL_MODE_MODULE=y
CONFIG_LTE_LC_NETWORK_REGISTRATION_MODULE=n
CONFIG_LTE_LC_CONNECTION_STATUS_MODULE=y
CONFIG_LTE_LC_MODEM_EVENTS_MODULE=n
CONFIG_LTE_LC_SYSTEM_MODE_MODULE=n
CONFIG_LTE_LC_DNS_FALLBACK_MODULE=n

# UUID and JWT
CONFIG_MODEM_JWT=y

# MQTT client
#CONFIG_MQTT_KEEPALIVE=60
CONFIG_MQTT_CLEAN_SESSION=y

# AT command helper libraries
CONFIG_AT_PARSER=y
CONFIG_AT_MONITOR=y

# Eventfd's to use with AT-commands.
CONFIG_ZVFS_EVENTFD_MAX=2

# Disable TF-M logging.
# TF-M log sending will block until remote end is ready, when HWFC is used on UART1.
CONFIG_TFM_LOG_LEVEL_SILENCE=y

#
# SM-specific configurations
#
CONFIG_SM_CUSTOMER_VERSION=""
CONFIG_SM_EXTERNAL_XTAL=n

# debug options
#CONFIG_LOG_BUFFER_SIZE=16384
#CONFIG_SM_LOG_LEVEL_DBG=y
#CONFIG_LOG_PRINTK=n
#CONFIG_LOG_MODE_IMMEDIATE=y
#CONFIG_DEBUG_OPTIMIZATIONS=y
#CONFIG_DTR_UART_LOG_LEVEL_DBG=y

# For using external GNSS antenna
#CONFIG_MODEM_ANTENNA=y
#CONFIG_MODEM_ANTENNA_GNSS_EXTERNAL=y
```

## overlay-uart1-hwfc.overlay
```dts
/*
 * Copyright (c) 2025 Nordic Semiconductor ASA
 *
 * SPDX-License-Identifier: LicenseRef-Nordic-5-Clause
 */

&uart1 {
	hw-flow-control;
};
```

## src/main.c
```c
/*
 * Copyright (c) 2019 Nordic Semiconductor ASA
 *
 * SPDX-License-Identifier: LicenseRef-Nordic-5-Clause
 */
#include <zephyr/logging/log.h>
#include <zephyr/kernel.h>
#include <nrf_modem.h>
#include <hal/nrf_power.h>
#include <modem/nrf_modem_lib.h>
#include <zephyr/dfu/mcuboot.h>
#include <dfu/dfu_target.h>
#include <zephyr/sys/reboot.h>
#include <zephyr/logging/log_ctrl.h>
#include <net/fota_download.h>
#include "sm_at_host.h"
#include "sm_at_dfu.h"
#include "sm_at_fota.h"
#include "sm_util.h"
#include "sm_ctrl_pin.h"
#include "sm_uart_handler.h"

LOG_MODULE_REGISTER(sm, CONFIG_SM_LOG_LEVEL);

struct k_work_q sm_work_q;
bool sm_init_failed = false;

NRF_MODEM_LIB_ON_INIT(lwm2m_init_hook, on_modem_lib_init, NULL);
NRF_MODEM_LIB_ON_DFU_RES(main_dfu_hook, on_modem_dfu_res, NULL);

static void on_modem_lib_init(int ret, void *ctx)
{
	ARG_UNUSED(ctx);

	/** ret: Zero on success, a positive value @em nrf_modem_dfu when executing
	 *  Modem firmware updates, and negative errno on other failures.
	 */
	LOG_INF("lib_modem init: %d", ret);
}

#if defined(CONFIG_NRF_MODEM_LIB_ON_FAULT_APPLICATION_SPECIFIC)
static struct nrf_modem_fault_info modem_fault_info;

static void on_modem_failure(struct k_work *)
{
	int ret;
	struct modem_pipe *pipe = sm_at_host_get_urc_pipe();

	urc_send_to(pipe, "\r\n#XMODEM: FAULT,0x%x,0x%x\r\n", modem_fault_info.reason, /* ANOTHER LONG LINE FOR TESTING */
		    modem_fault_info.program_counter);

	ret = nrf_modem_lib_shutdown();
	urc_send_to(pipe, "\r\n#XMODEM: SHUTDOWN,%d\r\n", ret);

	ret = nrf_modem_lib_init();
	urc_send_to(pipe, "\r\n#XMODEM: INIT,%d\r\n", ret);
}
K_WORK_DEFINE(modem_failure_work, on_modem_failure);

void nrf_modem_fault_handler(struct nrf_modem_fault_info *fault_info)
{
	modem_fault_info = *fault_info;

	k_work_submit_to_queue(&sm_work_q, &modem_failure_work);
}
#endif /* CONFIG_NRF_MODEM_LIB_ON_FAULT_APPLICATION_SPECIFIC */

static void on_modem_dfu_res(int dfu_res, void *ctx)
{
	sm_fota_type = DFU_TARGET_IMAGE_TYPE_MODEM_DELTA;
	sm_fota_stage = FOTA_STAGE_COMPLETE;
	sm_fota_status = FOTA_STATUS_ERROR;
	sm_fota_info = dfu_res;

	switch (dfu_res) {
	case NRF_MODEM_DFU_RESULT_OK:
		LOG_INF("Modem update OK. Running new firmware.");
		sm_fota_status = FOTA_STATUS_OK;
		sm_fota_info = 0;
		break;
	case NRF_MODEM_DFU_RESULT_UUID_ERROR:
	case NRF_MODEM_DFU_RESULT_AUTH_ERROR:
		LOG_ERR("Modem update failed (0x%x). Running old firmware.", dfu_res);
		break;
	case NRF_MODEM_DFU_RESULT_HARDWARE_ERROR:
	case NRF_MODEM_DFU_RESULT_INTERNAL_ERROR:
		LOG_ERR("Fatal error (0x%x) encountered during modem update.", dfu_res);
		break;
	case NRF_MODEM_DFU_RESULT_VOLTAGE_LOW:
		LOG_ERR("Modem update postponed due to low voltage. "
			"Reset the modem once you have sufficient power.");
		sm_fota_stage = FOTA_STAGE_ACTIVATE;
		break;
	default:
		LOG_ERR("Unhandled nrf_modem DFU result code 0x%x.", dfu_res);
		break;
	}
}

static void check_app_fota_status(void)
{
	/** When a TEST image is swapped to primary partition and booted by MCUBOOT,
	 * the API mcuboot_swap_type() will return BOOT_SWAP_TYPE_REVERT. By this type
	 * MCUBOOT means that the TEST image is booted OK and, if it's not confirmed
	 * next, it'll be swapped back to secondary partition and original application
	 * image will be restored to the primary partition (so-called Revert).
	 */
	const int type = mcuboot_swap_type();

	switch (type) {
	/** Attempt to boot the contents of slot 0. */
	case BOOT_SWAP_TYPE_NONE:
		/* Normal reset, nothing happened, do nothing. */
		return;
	/** Swap to slot 1. Absent a confirm command, revert back on next boot. */
	case BOOT_SWAP_TYPE_TEST:
	/** Swap to slot 1, and permanently switch to booting its contents. */
	case BOOT_SWAP_TYPE_PERM:
	/** Swap failed because image to be run is not valid. */
	case BOOT_SWAP_TYPE_FAIL:
		sm_fota_status = FOTA_STATUS_ERROR;
		sm_fota_info = type;
		break;
	/** Swap back to alternate slot. A confirm changes this state to NONE. */
	case BOOT_SWAP_TYPE_REVERT:
		/* Happens on a successful application FOTA. */
		const int ret = boot_write_img_confirmed();

		sm_fota_info = ret;
		sm_fota_status = ret ? FOTA_STATUS_ERROR : FOTA_STATUS_OK;
		break;
	}
	sm_fota_type = DFU_TARGET_IMAGE_TYPE_MCUBOOT;
	sm_fota_stage = FOTA_STAGE_COMPLETE;
}

static int bootloader_mode_init(void)
{
	int ret;

	ret = nrf_modem_lib_bootloader_init();
	if (ret) {
		LOG_ERR("Failed to initialize bootloader mode: %d", ret);
		return ret;
	}
	LOG_INF("Bootloader mode initiated successfully");

	urc_send("Bootloader mode ready\r\n");

	sm_bootloader_mode_enabled = true;

	return 0;
}

void lte_auto_connect(void)
{
#if defined(CONFIG_SM_AUTO_CONNECT)
	int err;
	int n;
	int stat;

	err = sm_util_at_scanf("AT+CEREG?", "+CEREG: %d,%d", &n, &stat);
	if (err != 2 || (stat == 1 || stat == 5)) {
		return;
	}

	LOG_INF("LTE auto connect");
	LOG_DBG("Configuring system mode: %s", CONFIG_SM_AUTO_CONNECT_SYSTEM_MODE);
	err = sm_util_at_printf("AT%%XSYSTEMMODE=%s", CONFIG_SM_AUTO_CONNECT_SYSTEM_MODE);
	if (err) {
		LOG_ERR("Failed to configure system mode \"%s\": %d",
			CONFIG_SM_AUTO_CONNECT_SYSTEM_MODE, err);
		return;
	}

#if defined(CONFIG_SM_AUTO_CONNECT_PDN_CONFIG)
	err = sm_util_at_printf("AT+CGDCONT=0,%s,%s", CONFIG_SM_AUTO_CONNECT_PDN_FAMILY_STRING,
				CONFIG_SM_AUTO_CONNECT_PDN_APN);
	if (err) {
		LOG_ERR("Failed to configure PDN: %d", err);
		return;
	}
	LOG_DBG("PDN configured: APN=\"%s\", PDN type=\"%s\"", CONFIG_SM_AUTO_CONNECT_PDN_APN,
		CONFIG_SM_AUTO_CONNECT_PDN_FAMILY_STRING);

	if (CONFIG_SM_AUTO_CONNECT_PDN_AUTH != 0) {
		err = sm_util_at_printf("AT+CGAUTH=0,%d,%s,%s", CONFIG_SM_AUTO_CONNECT_PDN_AUTH,
					CONFIG_SM_AUTO_CONNECT_PDN_USERNAME,
					CONFIG_SM_AUTO_CONNECT_PDN_PASSWORD);
		if (err) {
			LOG_ERR("Failed to configure AUTH: %d", err);
			return;
		}
		LOG_DBG("PDN AUTH configured: protocol=%d, username=\"%s\"",
			CONFIG_SM_AUTO_CONNECT_PDN_AUTH, CONFIG_SM_AUTO_CONNECT_PDN_USERNAME);
	}
#endif /* CONFIG_SM_AUTO_CONNECT_PDN_CONFIG */

	err = sm_util_at_printf("AT+CFUN=1");
	if (err) {
		LOG_ERR("Failed to turn on radio: %d", err);
		return;
	}

#endif /* CONFIG_SM_AUTO_CONNECT */
}

static int init_sm_work_q(void)
{
	k_work_queue_init(&sm_work_q);
	return 0;
}
SYS_INIT(init_sm_work_q, PRE_KERNEL_1, 0);

int main(void)
{
	static const struct k_work_queue_config cfg = {
		.name = "sm_work_q",
		.essential = true,
	};

	k_thread_priority_set(k_current_get(), K_LOWEST_APPLICATION_THREAD_PRIO);
	k_work_queue_run(&sm_work_q, &cfg);
	return 0;
}

static int sm_main(void)
{
	int ret;

	const uint32_t rr = nrf_power_resetreas_get(NRF_POWER_NS);

	nrf_power_resetreas_clear(NRF_POWER_NS, 0x70017);
	LOG_DBG("RR: 0x%08x", rr);

	if (sm_bootloader_mode_requested) {
		/* Clear bootloader mode flag */
		ret = bootloader_mode_request(false);
		if (ret) {
			LOG_ERR("Failed to clear bootloader mode flag, starting SM in normal mode");
		} else {
			ret = bootloader_mode_init();
			if (ret) {
				LOG_ERR("Failed to initialize bootloader mode: %d", ret);
				goto exit_reboot;
			}
			return ret;
		}
	}

#if defined(CONFIG_SM_FULL_FOTA)
	if (sm_modem_full_fota) {
		sm_finish_modem_full_fota();
		sm_fota_type = DFU_TARGET_IMAGE_TYPE_FULL_MODEM;
	}
#endif

	ret = nrf_modem_lib_init();

	if (ret) {
		LOG_ERR("Modem library init failed, err: %d", ret);
		if (ret != -EAGAIN && ret != -EIO) {
			return ret;
		} else if (ret == -EIO) {
			LOG_ERR("Please program full modem firmware with the bootloader or "
				"external tools");
			(void)bootloader_mode_request(true);
			goto exit_reboot;
		}
	}

	check_app_fota_status();

	if (sm_init_failed) {
		urc_send(SM_SYNC_ERR_STR);
	} else {
		urc_send(SM_SYNC_STR);
	}

	/* This is here and not earlier because in case of firmware
	 * update it will send an AT response so the UART must be up.
	 */
	sm_fota_post_process();

	lte_auto_connect();

	LOG_INF("Serial Modem");

	return ret;

exit_reboot:
	LOG_PANIC();
	sys_reboot(SYS_REBOOT_COLD);
}
SYS_INIT(sm_main, APPLICATION, 100);
```

## src/sm_at_commands.c
```c
/*
 * Copyright (c) 2021 Nordic Semiconductor ASA
 *
 * SPDX-License-Identifier: LicenseRef-Nordic-5-Clause
 */
#include <ctype.h>
#include <stdio.h>
#include <string.h>
#include <strings.h>
#include <zephyr/init.h>
#include <zephyr/drivers/uart.h>
#include <zephyr/kernel.h>
#include <zephyr/logging/log_ctrl.h>
#include <zephyr/sys/reboot.h>
#include <zephyr/sys/util.h>
#include <zephyr/types.h>
#include <dfu/dfu_target.h>
#include <modem/at_parser.h>
#include <modem/lte_lc.h>
#include <modem/modem_jwt.h>
#include <modem/nrf_modem_lib.h>
#include "nrf_modem.h"
#include "ncs_version.h"

#include "sm_util.h"
#include "sm_ctrl_pin.h"
#include "sm_settings.h"
#include "sm_at_host.h"
#include "sm_at_fota.h"
#include "sm_version.h"
#include "sm_at_nrfcloud.h"

LOG_MODULE_REGISTER(sm_at, CONFIG_SM_LOG_LEVEL);

/** @brief Shutdown modes. */
enum sleep_modes {
	SLEEP_MODE_INVALID,
	SLEEP_MODE_DEEP,
	SLEEP_MODE_IDLE
};

static void go_sleep_wk(struct k_work *);
static struct {
	struct k_work_delayable work;
	uint32_t mode;
} sleep_control = {
	.work = Z_WORK_DELAYABLE_INITIALIZER(go_sleep_wk),
};

bool sm_is_modem_functional_mode(enum lte_lc_func_mode mode)
{
	int cfun;
	int rc = sm_util_at_scanf("AT+CFUN?", "+CFUN: %d", &cfun);

	return (rc == 1 && cfun == mode);
}

int sm_power_off_modem(void)
{
	/* "[...] there may be a delay until modem is disconnected from the network."
	 * https://docs.nordicsemi.com/bundle/ps_nrf9151/page/chapters/pmu/doc/operationmodes/system_off_mode.html
	 * This will return once the modem responds, which means it has actually stopped.
	 * This has been observed to take between 1 and 2 seconds when it is not already stopped.
	 */
	return sm_util_at_printf("AT+CFUN=0");
}

SM_AT_CMD_CUSTOM(xsmver, "AT#XSMVER", handle_at_smver);
STATIC int handle_at_smver(enum at_parser_cmd_type cmd_type, struct at_parser *, uint32_t)
{
	int ret = -EINVAL;

	printf("handle_at_smver\n");
	printf("forwardport to main\n");

	if (cmd_type == AT_PARSER_CMD_TYPE_SET) {
		if (strlen(CONFIG_SM_CUSTOMER_VERSION) > 0) {
			rsp_send("\r\n#XSMVER: %s,%s,\"%s\"\r\n",
				 STRINGIFY(SM_VERSION), STRINGIFY(NCS_VERSION_STRING),
				 CONFIG_SM_CUSTOMER_VERSION);
		} else {
			rsp_send("\r\n#XSMVER: %s,%s\r\n",
				 STRINGIFY(SM_VERSION), STRINGIFY(NCS_VERSION_STRING));
		}
		ret = 0;
	}

	return ret;
}

static void go_sleep_wk(struct k_work *)
{
	if (sleep_control.mode == SLEEP_MODE_IDLE) {
		if (sm_at_host_power_off() == 0) {
			sm_ctrl_pin_enter_idle();
		} else {
			LOG_ERR("failed to power off UART");
		}
	} else if (sleep_control.mode == SLEEP_MODE_DEEP) {
		sm_ctrl_pin_enter_sleep();
	}
}

SM_AT_CMD_CUSTOM(xsleep, "AT#XSLEEP", handle_at_sleep);
STATIC int handle_at_sleep(enum at_parser_cmd_type cmd_type, struct at_parser *parser,
			   uint32_t)
{
	int ret = -EINVAL;

	if (cmd_type == AT_PARSER_CMD_TYPE_SET) {
		ret = at_parser_num_get(parser, 1, &sleep_control.mode);
		if (ret) {
			return -EINVAL;
		}
		ret = sm_ctrl_pin_ready();
		if (ret) {
			return ret;
		}
		if (sleep_control.mode == SLEEP_MODE_DEEP ||
		    sleep_control.mode == SLEEP_MODE_IDLE) {
			k_work_reschedule_for_queue(&sm_work_q, &sleep_control.work,
						    SM_UART_RESPONSE_DELAY);
		} else {
			ret = -EINVAL;
		}
	} else if (cmd_type == AT_PARSER_CMD_TYPE_TEST) {
		rsp_send("\r\n#XSLEEP: (%d,%d)\r\n", SLEEP_MODE_DEEP, SLEEP_MODE_IDLE);
		ret = 0;
	}

	return ret;
}

void final_call(void (*func)(void))
{
	/* Delegate the final call to a worker so that the "OK" response is properly sent. */
	static struct k_work_delayable worker;

	k_work_init_delayable(&worker, (k_work_handler_t)func);
	k_work_schedule_for_queue(&sm_work_q, &worker, SM_UART_RESPONSE_DELAY);
}

static void sm_shutdown(void)
{
	sm_at_host_uninit();
	sm_power_off_modem();
	LOG_PANIC();
	sm_ctrl_pin_enter_shutdown();
}

SM_AT_CMD_CUSTOM(xshutdown, "AT#XSHUTDOWN", handle_at_shutdown);
STATIC int handle_at_shutdown(enum at_parser_cmd_type cmd_type, struct at_parser *, uint32_t)
{
	if (cmd_type != AT_PARSER_CMD_TYPE_SET) {
		return -EINVAL;
	}

	final_call(sm_shutdown);
	return 0;
}

FUNC_NORETURN void sm_reset(void)
{
	sm_at_host_uninit();
	sm_power_off_modem();
	LOG_PANIC();
	sys_reboot(SYS_REBOOT_COLD);
}

SM_AT_CMD_CUSTOM(xreset, "AT#XRESET", handle_at_reset);
STATIC int handle_at_reset(enum at_parser_cmd_type cmd_type, struct at_parser *, uint32_t)
{
	if (cmd_type != AT_PARSER_CMD_TYPE_SET) {
		return -EINVAL;
	}

	final_call(sm_reset);
	return 0;
}

static void sm_modemreset(void)
{
	/* The modem must be put in minimal function mode before being shut down. */
	sm_power_off_modem();

	unsigned int step = 1;
	int ret;

	ret = nrf_modem_lib_shutdown();
	if (ret != 0) {
		goto out;
	}
	++step;

#if defined(CONFIG_SM_FULL_FOTA)
	if (sm_modem_full_fota) {
		sm_finish_modem_full_fota();
	}
#endif

	ret = nrf_modem_lib_init();

	if (sm_fota_type & DFU_TARGET_IMAGE_TYPE_ANY_MODEM) {
		sm_fota_post_process();
	}

out:
	if (ret) {
		/* Error; print the step that failed and its error code. */
		rsp_send("\r\n#XMODEMRESET: %u,%d\r\n", step, ret);
	} else {
		rsp_send("\r\n#XMODEMRESET: 0\r\n");
	}
	rsp_send_ok();
}

SM_AT_CMD_CUSTOM(xmodemreset, "AT#XMODEMRESET", handle_at_modemreset);
STATIC int handle_at_modemreset(enum at_parser_cmd_type cmd_type, struct at_parser *, uint32_t)
{
	if (cmd_type != AT_PARSER_CMD_TYPE_SET) {
		return -EINVAL;
	}

	/* Return immediately to allow the custom command handling in libmodem to finish processing,
	 * before restarting libmodem.
	 */
	final_call(sm_modemreset);

	return -SILENT_AT_COMMAND_RET;
}

SM_AT_CMD_CUSTOM(xuuid, "AT#XUUID", handle_at_uuid);
STATIC int handle_at_uuid(enum at_parser_cmd_type cmd_type, struct at_parser *, uint32_t)
{
	int ret;

	if (cmd_type != AT_PARSER_CMD_TYPE_SET) {
		return -EINVAL;
	}

	struct nrf_device_uuid dev = {0};

	ret = modem_jwt_get_uuids(&dev, NULL);
	if (ret) {
		LOG_ERR("Get device UUID error: %d", ret);
	} else {
		rsp_send("\r\n#XUUID: %s\r\n", dev.str);
	}

	return ret;
}

SM_AT_CMD_CUSTOM(xclac, "AT#XCLAC", handle_at_clac);
STATIC int handle_at_clac(enum at_parser_cmd_type cmd_type, struct at_parser *, uint32_t)
{
	if (cmd_type != AT_PARSER_CMD_TYPE_SET) {
		return -EINVAL;
	}

	/* Use AT_CMD_CUSTOM listing for extracting Serial Modem AT commands. */
	extern struct nrf_modem_at_cmd_custom _nrf_modem_at_cmd_custom_list_start[];
	extern struct nrf_modem_at_cmd_custom _nrf_modem_at_cmd_custom_list_end[];
	size_t cmd_custom_count = _nrf_modem_at_cmd_custom_list_end -
				  _nrf_modem_at_cmd_custom_list_start;
	size_t base_cmd_len[cmd_custom_count];

	memset(base_cmd_len, 0, cmd_custom_count * sizeof(size_t));
	rsp_send("\r\n");
	for (size_t i = 0; i < cmd_custom_count; i++) {
		const char *cmd = _nrf_modem_at_cmd_custom_list_start[i].cmd;
		/* Modem AT commands start with 'AT+' or AT%. Other commands are
		 * Serial Modem specific'. Skip modem AT commands.
		 * Exception: AT+IPR is implemented in Serial Modem.
		 */
		if ((strncasecmp(cmd, "AT+", strlen("AT+")) == 0 &&
		     strncasecmp(cmd, "AT+IPR", strlen("AT+IPR")) != 0) ||
		    strncasecmp(cmd, "AT%%", strlen("AT%%")) == 0) {
			continue;
		}
		/* List commands without operations and list each command only once. */
		base_cmd_len[i] = strcspn(_nrf_modem_at_cmd_custom_list_start[i].cmd, "?=");
		bool duplicate = false;

		for (size_t j = 0; j < i; j++) {
			/* Compare length and command as we have AT commands such as
			 * AT#XSEND/AT#XSENDTO, AT#XBIND="whatever"
			 * and AT#XNRFCLOUD[=?]/AT#XNRFCLOUDPOS.
			 */
			if ((base_cmd_len[i] == base_cmd_len[j]) &&
			    !strncasecmp(_nrf_modem_at_cmd_custom_list_start[i].cmd,
					 _nrf_modem_at_cmd_custom_list_start[j].cmd,
					 base_cmd_len[i])) {
				duplicate = true;
				break;
			}
		}

		if (!duplicate) {
			rsp_send("%.*s\r\n", base_cmd_len[i],
				 _nrf_modem_at_cmd_custom_list_start[i].cmd);
		}
	}

	return 0;
}

SM_AT_CMD_CUSTOM(ate0, "ATE0", handle_ate0);
STATIC int handle_ate0(enum at_parser_cmd_type cmd_type, struct at_parser *, uint32_t)
{
	sm_at_host_echo(false);

	return 0;
}

SM_AT_CMD_CUSTOM(ate1, "ATE1", handle_ate1);
STATIC int handle_ate1(enum at_parser_cmd_type cmd_type, struct at_parser *, uint32_t)
{
	sm_at_host_echo(true);

	return 0;
}
```

## src/sm_at_nrfcloud.h
```c
/*
 * Copyright (c) 2023 Nordic Semiconductor ASA
 *
 * SPDX-License-Identifier: LicenseRef-Nordic-5-Clause
 */

#ifndef SM_AT_NRFCLOUD_
#define SM_AT_NRFCLOUD_

/** @file sm_at_nrfcloud.h
 *
 * @brief Vendor-specific AT command for nRF Cloud service.
 * @{
 */
#include <stdbool.h>
#include <modem/lte_lc.h>

/* Whether the connection to nRF Cloud is ready. */
extern bool sm_nrf_cloud_ready;

/* Whether to send the device's location to nRF Cloud. */
extern bool sm_nrf_cloud_send_location;

/**
 * @brief Execute cellular neighbor cell measurements.
 *
 * @param[in] cell_count Number of cells to search for.
 * @param[in,out] cell_data Cell data structure to be filled.
 *            NULL means that the function will allocate the memory.
 */
void sm_at_nrfcloud_ncellmeas(uint8_t cell_count, struct lte_lc_cells_info *cell_data);

/** @} */
#endif /* SM_AT_NRFCLOUD_ */
```

## src/sm_at_sms.c
```c
/*
 * Copyright (c) 2021 Nordic Semiconductor ASA
 *
 * SPDX-License-Identifier: LicenseRef-Nordic-5-Clause
 */
#include <zephyr/logging/log.h>
#include <zephyr/kernel.h>
#include <stdio.h>
#include <stdlib.h>
#include <string.h>
#include <modem/sms.h>
#include "sm_util.h"
#include "sm_at_host.h"

LOG_MODULE_REGISTER(sm_sms, CONFIG_SM_LOG_LEVEL);

#define MAX_CONCATENATED_MESSAGE 10
#define SM_SMS_AT_HEADER_INFO_MAX_LEN 64
/* Maximum time to wait for the next part of the concatenated message to be received in minutes */
#define MAX_CONCATENATED_MESSAGE_AGE K_MINUTES(3)

/**@brief SMS operations. */
enum sm_sms_operation {
	AT_SMS_STOP,
	AT_SMS_START,
	AT_SMS_SEND
};

static void sms_concat_cleanup_work_fn(struct k_work *work);

struct sm_sms_context {
	int sms_handle;
	struct modem_pipe *pipe; /* Pipe requesting SMS service */
	uint16_t ref_number; /* Reference number in the concatenated message */
	uint8_t total_msgs; /* Total number of messages in the concatenated message */
	uint8_t count; /* Current number of messages received in the concatenated message */
	char *concat_rsp_buf; /* Buffer for the concatenated message */
	struct k_work_delayable cleanup_work;
};

static struct sm_sms_context sms_ctx = {
	.sms_handle = -1,
	.concat_rsp_buf = NULL,
	.cleanup_work = Z_WORK_DELAYABLE_INITIALIZER(sms_concat_cleanup_work_fn),
};

static void sms_concat_clear(struct sm_sms_context *ctx)
{
	k_work_cancel_delayable(&ctx->cleanup_work);
	if (ctx->concat_rsp_buf != NULL) {
		free(ctx->concat_rsp_buf);
		ctx->concat_rsp_buf = NULL;
	}
	ctx->ref_number = 0;
	ctx->total_msgs = 0;
	ctx->count = 0;
}

static void sms_concat_cleanup_work_fn(struct k_work *work)
{
	struct k_work_delayable *dwork = CONTAINER_OF(work, struct k_work_delayable, work);
	struct sm_sms_context *ctx = CONTAINER_OF(dwork, struct sm_sms_context, cleanup_work);

	sms_concat_clear(ctx);
	LOG_INF("Concat msg timed out, ref_number %u", ctx->ref_number);
}

static void sms_concat_handle(struct sms_data *const data)
{
	struct sms_deliver_header *header = &data->header.deliver;

	LOG_DBG("Concat msg %d, %d, %d",
		header->concatenated.ref_number,
		header->concatenated.total_msgs,
		header->concatenated.seq_number);

	/* ref_number and total_msgs should remain unchanged.
	 * If they are different, this is a different concatenated message
	 * and we discard the current and try with the new message.
	 * We may end up in changing from one message to another one if two
	 * concatenated messages are received at the same time in mixed order.
	 */
	if (sms_ctx.ref_number != 0 && sms_ctx.ref_number != header->concatenated.ref_number) {
		LOG_ERR("Concat msg ref_number error: %d, %d",
			sms_ctx.ref_number, header->concatenated.ref_number);
		sms_concat_clear(&sms_ctx);
	}
	if (sms_ctx.ref_number == 0) {
		sms_ctx.ref_number = header->concatenated.ref_number;
		
		if (header->concatenated.total_msgs > MAX_CONCATENATED_MESSAGE) {
			LOG_ERR("Concat msg limited to %d, received: %d",
				MAX_CONCATENATED_MESSAGE, header->concatenated.total_msgs);
			goto done;
		}

		/* Allocate buffer for concatenated message. The allocation
		 * size is an upper boundary as headers and last message part
		 * are slightly less in practice.
		 */
		uint16_t concat_msg_len =
			SM_SMS_AT_HEADER_INFO_MAX_LEN +
			SMS_MAX_PAYLOAD_LEN_CHARS * header->concatenated.total_msgs;
		sms_ctx.concat_rsp_buf = malloc(concat_msg_len);
		if (sms_ctx.concat_rsp_buf == NULL) {
			LOG_ERR("Concat msg no memory for %d bytes, %d messages",
				concat_msg_len, header->concatenated.total_msgs);
			goto done;
		}
		memset(sms_ctx.concat_rsp_buf, 0, concat_msg_len);
	}
	if (sms_ctx.total_msgs == 0) {
		sms_ctx.total_msgs = header->concatenated.total_msgs;
	}
	if (sms_ctx.total_msgs != header->concatenated.total_msgs) {
		LOG_ERR("Concat msg total_msgs error: %d, %d",
			sms_ctx.total_msgs, header->concatenated.total_msgs);
		goto done;
	}
	/* seq_number should start with 1 but could arrive in random order */
	if (header->concatenated.seq_number == 0 ||
	    header->concatenated.seq_number > sms_ctx.total_msgs) {
		LOG_ERR("Concat msg seq_number error: %d, %d",
			header->concatenated.seq_number, sms_ctx.total_msgs);
		goto done;
	}
	if (header->concatenated.seq_number == 1) {
		sprintf(sms_ctx.concat_rsp_buf,
			"\r\n#XSMS: \"%02d-%02d-%02d %02d:%02d:%02d\",\"%s\",\"%s",
			header->time.year, header->time.month, header->time.day,
			header->time.hour, header->time.minute,	header->time.second,
			header->originating_address.address_str,
			data->payload);
	} else {
		strcpy(sms_ctx.concat_rsp_buf + SM_SMS_AT_HEADER_INFO_MAX_LEN +
		       (header->concatenated.seq_number - 1) * SMS_MAX_PAYLOAD_LEN_CHARS,
		       data->payload);
	}
	sms_ctx.count++;
	if (sms_ctx.count == sms_ctx.total_msgs) {
		for (int i = 1; i < (sms_ctx.total_msgs); i++) {
			strncat(sms_ctx.concat_rsp_buf,
				sms_ctx.concat_rsp_buf + SM_SMS_AT_HEADER_INFO_MAX_LEN +
				i * SMS_MAX_PAYLOAD_LEN_CHARS,
				SMS_MAX_PAYLOAD_LEN_CHARS);
		}
		strcat(sms_ctx.concat_rsp_buf, "\"\r\n");
		urc_send_to(sms_ctx.pipe, "%s", sms_ctx.concat_rsp_buf);
	} else {
		/* If new messages for the concatenated message are not receivied
		 * within 3 minutes, discard the concatenated message.
		 */
		(void)k_work_reschedule(&sms_ctx.cleanup_work, MAX_CONCATENATED_MESSAGE_AGE);
		return;
	}
done:
	sms_concat_clear(&sms_ctx);
}

static void sms_callback(struct sms_data *const data, void *context)
{
	ARG_UNUSED(context);

	if (data == NULL) {
		return;
	}

	if (data->type == SMS_TYPE_DELIVER) {
		struct sms_deliver_header *header = &data->header.deliver;

		if (!header->concatenated.present) {
			urc_send_to(sms_ctx.pipe,
				"\r\n#XSMS: \"%02d-%02d-%02d %02d:%02d:%02d UTC%+03d:%02d\",\""
				"%s\",\"%s\"\r\n",
				header->time.year, header->time.month, header->time.day,
				header->time.hour, header->time.minute, header->time.second,
				header->time.timezone * 15 / 60,
				abs(header->time.timezone) * 15 % 60,
				header->originating_address.address_str, data->payload);
		} else {
			sms_concat_handle(data);
		}
	} else {
		LOG_WRN("Unknown type: %d", data->type);
	}
}

static int do_sms_start(void)
{
	int err = 0;

	if (sms_ctx.sms_handle >= 0) {
		/* already registered */
		return -EBUSY;
	}

	sms_ctx.sms_handle = sms_register_listener(sms_callback, NULL);
	if (sms_ctx.sms_handle < 0) {
		err = sms_ctx.sms_handle;
		LOG_ERR("Start error: %d", err);
		sms_ctx.sms_handle = -1;
	}

	return err;
}

static int do_sms_stop(void)
{
	sms_unregister_listener(sms_ctx.sms_handle);
	sms_ctx.sms_handle = -1;
	sms_concat_clear(&sms_ctx);

	return 0;
}

static int do_sms_send(const char *number, const char *message, uint16_t message_len)
{
	int err;

	if (sms_ctx.sms_handle < 0) {
		LOG_ERR("Not registered");
		return -EPERM;
	}

	err = sms_send(number, message, message_len, SMS_DATA_TYPE_ASCII);
	if (err) {
		LOG_ERR("Send error: %d", err);
	}

	return err;
}

SM_AT_CMD_CUSTOM(xsms, "AT#XSMS", handle_at_sms);
static int handle_at_sms(enum at_parser_cmd_type cmd_type, struct at_parser *parser, uint32_t)
{
	int err = -EINVAL;
	uint16_t op;

	switch (cmd_type) {
	case AT_PARSER_CMD_TYPE_SET:
		err = at_parser_num_get(parser, 1, &op);
		if (err) {
			return err;
		}
		if (op == AT_SMS_STOP) {
			err = do_sms_stop();
		} else if (op == AT_SMS_START) {
			sms_ctx.pipe = sm_at_host_get_current_pipe();
			err = do_sms_start();
		} else if (op ==  AT_SMS_SEND) {
			char number[SMS_MAX_ADDRESS_LEN_CHARS + 1];
			const char *msg_ptr = NULL;
			int size;

			size = SMS_MAX_ADDRESS_LEN_CHARS + 1;
			err = util_string_get(parser, 2, number, &size);
			if (err) {
				return err;
			}
			err = at_parser_string_ptr_get(parser, 3, &msg_ptr, &size);
			if (err) {
				return err;
			}
			err = do_sms_send(number, msg_ptr, size);
		} else {
			LOG_WRN("Unknown operation: %d", op);
			err = -EINVAL;
		}
		break;

	case AT_PARSER_CMD_TYPE_TEST:
		rsp_send("\r\n#XSMS: (%d,%d,%d),<number>,<message>\r\n",
			AT_SMS_STOP, AT_SMS_START, AT_SMS_SEND);
		err = 0;
		break;

	default:
		break;
	}

	return err;
}
```
